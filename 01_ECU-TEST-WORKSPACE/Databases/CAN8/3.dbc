VERSION "V3.0"

NS_ :

BS_:

BU_: VCU BypassValve

BO_ 869 CommandMsg: 2 VCU
 SG_ PositionRef : 0|16@1+ (0.1,0) [0|1000] "%" Vector__XXX

BO_ 885 StatusMsg: 2 BypassValve
 SG_ Position : 0|16@1+ (0.1,0) [0|1000] "%" Vector__XXX

BO_ 837 DiagnosticMsg: 5 BypassValve
 SG_ DeviceID3 m9 : 8|32@1+ (1,0) [0|4294967295] "" Vector__XXX
 SG_ DeviceID2 m8 : 8|32@1+ (1,0) [0|4294967295] "" Vector__XXX
 SG_ DeviceID1 m7 : 8|32@1+ (1,0) [0|4294967295] "" Vector__XXX
 SG_ CommandID m3 : 8|16@1+ (1,0) [0|65535] "" Vector__XXX
 SG_ BootloaderVersion m6 : 8|16@1+ (1,0) [0|65535] "" Vector__XXX
 SG_ BootloaderUpdateCounter m6 : 24|16@1+ (1,0) [0|65535] "" Vector__XXX
 SG_ OperationError m16 : 8|16@1+ (1,0) [0|65535] "" Vector__XXX
 SG_ SelfcheckStatus m1 : 8|16@1+ (1,0) [0|65535] "" Vector__XXX
 SG_ DiagnosticHeader M : 0|8@1+ (1,0) [0|255] "" Vector__XXX
 SG_ MasterID m2 : 8|16@1+ (1,0) [0|65535] "" Vector__XXX
 SG_ StatusID m3 : 24|16@1+ (1,0) [0|0] "" Vector__XXX
 SG_ FirmwareVersion m4 : 8|16@1+ (1,0) [0|0] "" Vector__XXX
 SG_ ParameterVersion m4 : 24|16@1+ (1,0) [0|65535] "" Vector__XXX
 SG_ OperationCounter m5 : 8|32@1+ (1,0) [0|4294967295] "s" Vector__XXX

BA_DEF_ BO_  "GenMsgSendType" ENUM  "cyclic","reserved","cyclicIfActive","reserved","noMsgSendType";
BA_DEF_ BO_  "GenMsgCycleTime" INT 50 2000;
BA_DEF_ BO_  "GenMsgILSupport" ENUM  "No","Yes";
BA_DEF_ BU_  "ILUsed" ENUM  "No","Yes";
BA_DEF_ BU_  "NodeLayerModules" STRING ;
BA_DEF_  "Baudrate" INT 0 1000;
BA_DEF_  "DBName" STRING ;
BA_DEF_DEF_  "GenMsgSendType" "cyclic";
BA_DEF_DEF_  "GenMsgCycleTime" 50;
BA_DEF_DEF_  "GenMsgILSupport" "Yes";
BA_DEF_DEF_  "ILUsed" "Yes";
BA_DEF_DEF_  "NodeLayerModules" "CANoeILNLDefault.dll";
BA_DEF_DEF_  "Baudrate" 1000;
BA_DEF_DEF_  "DBName" "PTFC Bypass Valve";
BA_ "DBName" "PTFCBypassValve";
BA_ "GenMsgCycleTime" BO_ 869 100;
BA_ "GenMsgCycleTime" BO_ 885 100;
